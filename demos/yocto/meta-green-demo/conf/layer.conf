## demos/yocto/meta-green-demo/conf/layer.conf
```bitbake
BBPATH .= ":${LAYERDIR}"
BBFILES += "${LAYERDIR}/recipes-*/*/*.bb ${LAYERDIR}/recipes-*/*/*.bbappend"

BBFILE_COLLECTIONS += "meta-green-demo"
BBFILE_PATTERN_meta-green-demo = "^${LAYERDIR}/"
BBFILE_PRIORITY_meta-green-demo = "6"

LAYERDEPENDS_meta-green-demo = "core meta-green"
LAYERSERIES_COMPAT_meta-green-demo = "wrynose"
```

## demos/yocto/meta-green/conf/distro/green.conf
```bitbake
require conf/distro/poky.conf

DISTRO = "green"
DISTRO_NAME = "Green embedded Linux (EECONE reference)"
DISTRO_VERSION = "1.0"
SDK_VENDOR = "-greensdk"
MAINTAINER = "Lenka Koskova Triskova <lenka.koskova.triskova@tul.cz>"

INIT_MANAGER = "systemd"

DISTRO_FEATURES:remove = "3g nfc x11 wayland vulkan opengl pulseaudio bluetooth wifi zeroconf pci alsa pcmcia usbgadget"

INHERIT += "buildhistory"
BUILDHISTORY_COMMIT = "1"

INHERIT += "image-buildinfo"

BB_GENERATE_MIRROR_TARBALLS = "1"

require conf/distro/include/green-power.inc
```

## demos/yocto/meta-green/conf/distro/include/green-power.inc
```bitbake
# kernel side: recipes-kernel/linux/files/green-power.cfg
DISTRO_FEATURES:append = " pm"
```

## demos/yocto/meta-green/conf/layer.conf
```bitbake
BBPATH .= ":${LAYERDIR}"
BBFILES += "${LAYERDIR}/recipes-*/*/*.bb ${LAYERDIR}/recipes-*/*/*.bbappend"

BBFILE_COLLECTIONS += "meta-green"
BBFILE_PATTERN_meta-green = "^${LAYERDIR}/"
BBFILE_PRIORITY_meta-green = "6"

LAYERDEPENDS_meta-green = "core"
LAYERSERIES_COMPAT_meta-green = "wrynose"
```
